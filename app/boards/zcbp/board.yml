## app/boards/zcbp/board.yml
```yaml
board:
  name: zcbp
  full_name: Zephyr Course Black Pill V3.0
  vendor: weact
  socs:
    - name: stm32f401xe
```

## app/boards/zcbp_scratch/Kconfig.zcbp_scratch
```kconfig
# Copyright (c) 2020 Kalyan Sriram
# SPDX-License-Identifier: Apache-2.0

config BOARD_ZCBP_SCRATCH
	select SOC_STM32F401XE
```

## app/boards/zcbp_scratch/board.yml
```yaml
board:
  name: zcbp_scratch
  full_name: Zephyr Course Scratch Black Pill V3.0
  vendor: weact
  socs:
    - name: stm32f401xe
```
